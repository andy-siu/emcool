## main/Kconfig.projbuild
```kconfig
menu "emcool"

    config EMCOOL_CAN_TX_GPIO
        int "CAN transceiver TXD GPIO (ESP32-S3 -> transceiver)"
        range -1 48
        default 7
        help
            The GPIO wired to the CAN transceiver's TXD pin. 7 on the Autosport Labs
            ESP32-CAN-X2: its CAN1 transceiver. -1 keeps the CAN bus off. Listen-only mode
            never transmits, but the pin is still routed so the controller holds TXD
            recessive.

    config EMCOOL_CAN_RX_GPIO
        int "CAN transceiver RXD GPIO (transceiver -> ESP32-S3)"
        range -1 48
        default 6
        help
            The GPIO wired to the CAN transceiver's RXD pin. 6 on the ESP32-CAN-X2: its CAN1
            transceiver. -1 keeps the CAN bus off.

    menu "microSD card (ride log)"

        config EMCOOL_SD_SCK_GPIO
            int "SCK GPIO"
            range -1 48
            default 15
            help
                The card's clock. -1 leaves the ride log off.

        config EMCOOL_SD_MOSI_GPIO
            int "MOSI GPIO"
            range -1 48
            default 5
            help
                The card's CMD (data in).

        config EMCOOL_SD_MISO_GPIO
            int "MISO GPIO"
            range -1 48
            default 16
            help
                The card's DAT0 (data out). Not a strapping pin (0, 3, 45, 46): the card's
                pull-up would hold it at reset.

        config EMCOOL_SD_CS_GPIO
            int "CS GPIO"
            range -1 48
            default 4
            help
                The card's chip select (CD/DAT3).

    endmenu


endmenu
```
